## package/pf_ring/Config.in
```kconfig
config BR2_PACKAGE_PF_RING
	bool "pf_ring"
	help
	  PF_RING is a Linux kernel module and user-space framework
	  that allows you to process packets at high-rates while
	  providing you a consistent API for packet processing
	  applications.

	  http://www.ntop.org/get-started/download/#PF_RING
```
